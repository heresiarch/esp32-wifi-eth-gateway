## main/Kconfig.projbuild.example
```kconfig
menu "Project Network Configuration"

    menu "Wi-Fi Settings"
        config WIFI_SSID
            string "Wi-Fi SSID"
            default "My_Home_WiFi"
            help
                The SSID (name) of your Wi-Fi access point.
        config WIFI_PASSWORD
            string "Wi-Fi Password"
            default "super_secret_password"
            help
                The password for your Wi-Fi network. Leave blank if open.
    endmenu

    menu "Ethernet & Proxy Settings"
        config ETHERNET_IP
            string "Ethernet Static IP Address"
            default "10.0.0.1"
            help
                Static IP address assigned to the Ethernet interface.

        config ETHERNET_NETMASK
            string "Ethernet Netmask"
            default "255.255.255.0"
            help
                Subnet mask for the Ethernet network (e.g., 255.255.255.0).

        config ETHERNET_GATEWAY
            string "Ethernet Gateway"
            default "10.0.0.1"
            help
                Subnet mask for the Ethernet network (e.g., 255.255.255.0).
              
        config SERVER_LISTEN_PORT
            int "Server Listen Port"
            default 8888
            range 1 65535
            help
                The local port number the ESP32 server will listen on for incoming connections.

        config PROXY_TARGET_ADDRESS
            string "Proxy Target Address"
            #default "192.168.178.5"
            default "192.168.4.2"
            help
                The IP address or domain name of the remote proxy target server.

        config PROXY_TARGET_PORT
            int "Proxy Target Port"
            default 8888
            range 1 65535
            help
                The port number of the remote proxy target server.

        config SECOND_PROXY_ENABLE
            bool "Enable Second Proxy"
            default y
            help
                Enable a second, independent proxy instance with its own listen port and target. When disabled, only the first proxy runs and the second proxy settings are hidden.

        config SECOND_SERVER_LISTEN_PORT
            int "Second Server Listen Port"
            depends on SECOND_PROXY_ENABLE
            default 502
            range 1 65535
            help
                The local port number (1-65535) on which the second proxy instance listens for incoming connections. Default 502 is the Modbus TCP port. Must differ from the Server Listen Port.

        config SECOND_PROXY_TARGET_ADDRESS
            string "Second Proxy Target Address"
            depends on SECOND_PROXY_ENABLE
            default "192.168.4.2"
            help
                The IP address or domain name of the remote target server for the second proxy instance.

        config SECOND_PROXY_TARGET_PORT
            int "Second Proxy Target Port"
            depends on SECOND_PROXY_ENABLE
            default 502
            range 1 65535
            help
                The port number (1-65535) of the remote target server for the second proxy instance.
    endmenu

endmenu
```
